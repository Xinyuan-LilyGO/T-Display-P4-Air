## main/Kconfig.projbuild
```kconfig
menu "Example Configuration"

    choice
        prompt "Select the example to build"
        default EXAMPLE_BUILD_IPERF
            config EXAMPLE_BUILD_IPERF
                bool "iperf"
            config EXAMPLE_BUILD_IR_NEC_TRANSCEIVER
                bool "ir_nec_transceiver"
            config EXAMPLE_BUILD_NRF9151_UART
                bool "nrf9151_uart"
            config EXAMPLE_BUILD_RF_TEST
                bool "rf_test"
    endchoice

endmenu
```

## sdkconfig.defaults
```kconfig
CONFIG_LILYGO_DEVICE_DRIVER_T_DISPLAY_P4_AIR=y

CONFIG_IDF_TARGET="esp32p4"
CONFIG_ESPTOOLPY_FLASHSIZE_16MB=y
CONFIG_PARTITION_TABLE_CUSTOM=y
CONFIG_PARTITION_TABLE_CUSTOM_FILENAME="partitions_esp32p4.csv"

CONFIG_SPIRAM=y
CONFIG_SPIRAM_MODE_HEX=y
CONFIG_SPIRAM_SPEED_200M=y

CONFIG_CACHE_L2_CACHE_256KB=y
CONFIG_CACHE_L2_CACHE_LINE_128B=y

CONFIG_IDF_EXPERIMENTAL_FEATURES=y

CONFIG_FREERTOS_TIMER_TASK_STACK_DEPTH=8192
CONFIG_VFS_MAX_COUNT=16

CONFIG_SLAVE_IDF_TARGET_ESP32C5=y
CONFIG_ESP_HOSTED_AUTO_INIT=n
CONFIG_ESP_HOSTED_SDIO_GPIO_RESET_SLAVE=100

CONFIG_SPIFFS_OBJ_NAME_LEN=128
```
